## sdkconfig.defaults
```kconfig
# --- 目标芯片 ---
CONFIG_IDF_TARGET="esp32c3"
# 注:ESP32-C3 无 PSRAM,故不设 CONFIG_SPIRAM。

# --- Flash ---
# FoloToy AI Passport 的所有硬件批次均使用 8MB Flash。
CONFIG_ESPTOOLPY_FLASHSIZE_8MB=y
# 烧录时按实际探测容量回写镜像头。
CONFIG_ESPTOOLPY_HEADER_FLASHSIZE_UPDATE=y

# 牛来应用内嵌全屏 RGB565 动画与 PCM 音频，固件超过默认 1MB factory 分区。
CONFIG_PARTITION_TABLE_CUSTOM=y
CONFIG_PARTITION_TABLE_CUSTOM_FILENAME="partitions.csv"

# --- 控制台:USB-Serial-JTAG(C3 原生 USB,GPIO18/19)---
# 不用 UART0:其默认 TX=GPIO21 与本板背光引脚冲突。
CONFIG_ESP_CONSOLE_USB_SERIAL_JTAG=y
CONFIG_ESP_CONSOLE_SECONDARY_NONE=y

# --- LVGL ---
CONFIG_LV_COLOR_DEPTH_16=y
CONFIG_LV_FONT_MONTSERRAT_12=y
CONFIG_LV_FONT_MONTSERRAT_16=y
CONFIG_LV_FONT_MONTSERRAT_22=y
# LVGL 内置 malloc 池大小(KB)。它是独立静态区、不与系统堆共享,配大了会白白占用 RAM。
# 当前应用 UI 使用 24KB;扩展界面后若绘制卡死或触发看门狗,先检查内存再调整。
CONFIG_LV_MEM_SIZE_KILOBYTES=24

# --- 系统 ---
CONFIG_FREERTOS_HZ=1000
CONFIG_ESP_SLEEP_GPIO_ENABLE_INTERNAL_RESISTORS=n
```
